## qcom/opensource/touch-drivers/focaltech_touch_3683/Kconfig
```kconfig
config TOUCHSCREEN_FOCALTECH_TOUCH_3683
	tristate "focaltech 3683 touchscreen"
	default n
	help
	  Say Y here if you have a focaltech series touch controller
	  to your system.
	  If build module, say M.
	  If unsure, say N.
```
